/* Copyright (c) 2013, The Linux Foundation. All rights reserved.
 *
 * This program is free software; you can redistribute it and/or modify
 * it under the terms of the GNU General Public License version 2 and
 * only version 2 as published by the Free Software Foundation.
 *
 * This program is distributed in the hope that it will be useful,
 * but WITHOUT ANY WARRANTY; without even the implied warranty of
 * MERCHANTABILITY or FITNESS FOR A PARTICULAR PURPOSE.  See the
 * GNU General Public License for more details.
 */

/*---------------------------------------------------------------------------
 * This file is autogenerated file using gcdb parser. Please do not edit it.
 * Update input XML file to add a new entry or update variable in this file
 * VERSION = "1.0"
 *---------------------------------------------------------------------------*/
&mdss_mdp {
	dsi_boe_2k_vid: qcom,mdss_dsi_boe_2k_video {
		qcom,mdss-dsi-panel-name = "BOE 2K video mode dsi panel";
		qcom,mdss-dsi-panel-controller = <&mdss_dsi0>;
		qcom,mdss-dsi-panel-type = "dsi_video_mode";
		qcom,mdss-dsi-panel-destination = "display_1";
		qcom,mdss-dsi-virtual-channel-id = <0>;
		qcom,mdss-dsi-stream = <0>;
		qcom,mdss-pan-physical-width-dimension = <68>;
		qcom,mdss-pan-physical-height-dimension = <147>;
		qcom,mdss-dsi-bpp = <24>;
		qcom,mdss-dsi-color-order = "rgb_swap_rgb";
		qcom,mdss-dsi-underflow-color = <0xff>;
		qcom,mdss-dsi-border-color = <0>;
		qcom,mdss-dsi-traffic-mode = "burst_mode";
		qcom,mdss-dsi-lane-map = "lane_map_0123";
		qcom,mdss-dsi-bllp-eof-power-mode;
		qcom,mdss-dsi-bllp-power-mode;
		qcom,mdss-dsi-lane-0-state;
		qcom,mdss-dsi-lane-1-state;
		qcom,mdss-dsi-lane-2-state;
		qcom,mdss-dsi-lane-3-state;
		qcom,mdss-dsi-lp11-init;
		qcom,mdss-dsi-dma-trigger = "trigger_sw";
		qcom,mdss-dsi-mdp-trigger = "none";
		qcom,mdss-dsi-reset-sequence = <1 3>, <0 1>, <1 10>;
		qcom,ulps-enabled;

		//for ESD check
		//The status value of reg 0xac is valid if the last bit is 0
		//We mark status value 0xff here and do sanity check at dsi_display.c
		qcom,esd-check-enabled;
		qcom,mdss-dsi-panel-status-check-mode = "reg_read";
		qcom,mdss-dsi-panel-status-command = [06 01 00 01 00 00 01 ac];
		qcom,mdss-dsi-panel-status-valid-params = <1>;
		qcom,mdss-dsi-panel-status-value = <0xff>;
		qcom,mdss-dsi-panel-status-command-state = "dsi_hs_mode";
		qcom,mdss-dsi-panel-status-read-length = <1>;

		//for HDR support
		qcom,mdss-dsi-panel-hdr-enabled;
		qcom,mdss-dsi-panel-hdr-color-primaries = <15300 16000 34000 16000 13250 34500 7500 3000>;
		qcom,mdss-dsi-panel-peak-brightness = <5500000>;
		qcom,mdss-dsi-panel-blackness-level = <4000>;

		qcom,mdss-dsi-display-timings {
			timing@0{
				qcom,mdss-dsi-panel-width = <1080>;
				qcom,mdss-dsi-panel-height = <2340>;
				qcom,mdss-dsi-h-front-porch = <46>;
				qcom,mdss-dsi-h-back-porch = <40>;
				qcom,mdss-dsi-h-pulse-width = <4>;
				qcom,mdss-dsi-h-sync-skew = <0>;
				qcom,mdss-dsi-v-back-porch = <12>;
				qcom,mdss-dsi-v-front-porch = <112>;
				qcom,mdss-dsi-v-pulse-width = <4>;
				qcom,mdss-dsi-h-left-border = <0>;
				qcom,mdss-dsi-h-right-border = <0>;
				qcom,mdss-dsi-v-top-border = <0>;
				qcom,mdss-dsi-v-bottom-border = <0>;
				qcom,mdss-dsi-panel-framerate = <60>;
				qcom,mdss-dsi-on-command = [
					39 01 00 00 00 00 02 00 00
					39 01 00 00 00 00 04 FF 87 19 01
					39 01 00 00 00 00 02 00 80
					39 01 00 00 00 00 03 FF 87 19
					39 01 00 00 00 00 02 00 B5
					39 01 00 00 00 00 02 CA 04
					39 01 00 00 00 00 02 00 B2
					39 01 00 00 00 00 02 CA 0C
					39 01 00 00 00 00 02 00 B0
					39 01 00 00 00 00 02 CA 00
					39 01 00 00 00 00 02 00 B1
					39 01 00 00 00 00 02 CA 00
					39 01 00 00 00 00 02 00 B5
					39 01 00 00 00 00 02 CA 07
					39 01 00 00 00 00 02 00 80
					39 01 00 00 00 00 09 C9 80 50 60 70 78 80 b0 e0
					39 01 00 00 00 00 02 00 80
					39 01 00 00 00 00 0D CA a0 9e 9a 97 93 90 8e 8b 89 86 84 82
					39 01 00 00 00 00 02 00 90
					39 01 00 00 00 00 0A CA fd ff c2 fb ff ae f9 ff 99
					39 01 00 00 00 00 02 00 A0
					39 01 00 00 00 00 04 CA 07 07 07
					39 01 00 00 00 00 02 00 80
					39 01 00 00 00 00 03 FF 00 00
					39 01 00 00 00 00 02 00 00
					39 01 00 00 00 00 04 FF 00 00 00
					39 01 00 00 00 00 03 51 00 00
					39 01 00 00 00 00 02 53 24
					39 01 00 00 00 00 02 55 00
					39 01 00 00 55 00 01 11
					39 01 00 00 01 00 01 29];
				qcom,mdss-dsi-dim-on-command = [
					39 01 00 00 00 00 02 00 00
					39 01 00 00 00 00 04 FF 87 19 01
					39 01 00 00 00 00 02 00 80
					39 01 00 00 00 00 03 FF 87 19
					39 01 00 00 00 00 02 00 B5
					39 01 00 00 00 00 02 CA 04
					39 01 00 00 00 00 02 00 B2
					39 01 00 00 00 00 02 CA 0C
					39 01 00 00 00 00 02 00 B0
					39 01 00 00 00 00 02 CA 00
					39 01 00 00 00 00 02 00 B1
					39 01 00 00 00 00 02 CA 00
					39 01 00 00 00 00 02 00 B5
					39 01 00 00 00 00 02 CA 07
					39 01 00 00 00 00 02 00 80
					39 01 00 00 00 00 09 C9 80 50 60 70 78 80 b0 e0
					39 01 00 00 00 00 02 00 80
					39 01 00 00 00 00 0D CA a0 9e 9a 97 93 90 8e 8b 89 86 84 82
					39 01 00 00 00 00 02 00 90
					39 01 00 00 00 00 0A CA fd ff c2 fb ff ae f9 ff 99
					39 01 00 00 00 00 02 00 A0
					39 01 00 00 00 00 04 CA 07 07 07
					39 01 00 00 00 00 02 00 80
					39 01 00 00 00 00 03 FF 00 00
					39 01 00 00 00 00 02 00 00
					39 01 00 00 00 00 04 FF 00 00 00
					39 01 00 00 00 00 03 51 00 00
					39 01 00 00 00 00 02 53 2C
					39 01 00 00 00 00 02 55 00
					39 01 00 00 55 00 01 11
					39 01 00 00 01 00 01 29];
				qcom,mdss-dsi-off-command = [
					05 01 00 00 03 00 02 28 00
					05 01 00 00 80 00 02 10 00
					15 01 00 00 00 00 02 00 00
					39 01 00 00 00 00 05 F7 5A A5 95 27];
				qcom,mdss-dsi-on-command-state = "dsi_lp_mode";
				qcom,mdss-dsi-off-command-state = "dsi_lp_mode";
				qcom,mdss-dsi-h-sync-pulse = <1>;
			};
		};

	};
};

