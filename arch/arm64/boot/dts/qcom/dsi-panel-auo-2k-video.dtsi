/* Copyright (c) 2013, The Linux Foundation. All rights reserved.
 *
 * This program is free software; you can redistribute it and/or modify
 * it under the terms of the GNU General Public License version 2 and
 * only version 2 as published by the Free Software Foundation.
 *
 * This program is distributed in the hope that it will be useful,
 * but WITHOUT ANY WARRANTY; without even the implied warranty of
 * MERCHANTABILITY or FITNESS FOR A PARTICULAR PURPOSE.  See the
 * GNU General Public License for more details.
 */

/*---------------------------------------------------------------------------
 * This file is autogenerated file using gcdb parser. Please do not edit it.
 * Update input XML file to add a new entry or update variable in this file
 * VERSION = "1.0"
 *---------------------------------------------------------------------------*/
&mdss_mdp {
	dsi_auo_2k_vid: qcom,mdss_dsi_auo_2k_video {
		qcom,mdss-dsi-panel-name = "AUO 2K video mode dsi panel";
		qcom,mdss-dsi-panel-controller = <&mdss_dsi0>;
		qcom,mdss-dsi-panel-type = "dsi_video_mode";
		qcom,mdss-dsi-panel-destination = "display_1";
		//qcom,mdss-dsi-panel-framerate = <60>;
		qcom,mdss-dsi-virtual-channel-id = <0>;
		qcom,mdss-dsi-stream = <0>;
		//qcom,mdss-dsi-panel-width = <1080>;
		//qcom,mdss-dsi-panel-height = <2246>;
		qcom,mdss-pan-physical-width-dimension = <68>;
		qcom,mdss-pan-physical-height-dimension = <141>;
		//qcom,mdss-dsi-h-front-porch = <78>;
		//qcom,mdss-dsi-h-back-porch = <78>;
		//qcom,mdss-dsi-h-pulse-width = <12>;
		//qcom,mdss-dsi-h-sync-skew = <0>;
		//qcom,mdss-dsi-v-back-porch = <16>;
		//qcom,mdss-dsi-v-front-porch = <16>;
		//qcom,mdss-dsi-v-pulse-width = <2>;
		//qcom,mdss-dsi-h-left-border = <0>;
		//qcom,mdss-dsi-h-right-border = <0>;
		//qcom,mdss-dsi-v-top-border = <0>;
		//qcom,mdss-dsi-v-bottom-border = <0>;
		qcom,mdss-dsi-bpp = <24>;
		qcom,mdss-dsi-color-order = "rgb_swap_rgb";
		qcom,mdss-dsi-underflow-color = <0xff>;
		qcom,mdss-dsi-border-color = <0>;
		qcom,mdss-dsi-on-command = [
			// CMD2 mode on
			39 01 00 00 00 00 02 00 00
			39 01 00 00 00 00 04 FF 87 16 01
			39 01 00 00 00 00 02 00 80
			39 01 00 00 00 00 03 FF 87 16
			// resolution 1080x2246
			39 01 00 00 00 00 02 00 00
			39 01 00 00 00 00 05 2A 00 00 04 37
			39 01 00 00 00 00 02 00 00
			39 01 00 00 00 00 05 2B 00 00 08 C5
			// PWM Freq. = 34.18K
			39 01 00 00 00 00 02 00 B0
			39 01 00 00 00 00 03 CA 00 00
			// PWM = 10bit
			39 01 00 00 00 00 02 00 B2
			39 01 00 00 00 00 02 CA 04
			// Dimming Frame = 32
			39 01 00 00 00 00 02 00 B5
			39 01 00 00 00 00 02 CA 20
			//reload the error OTP set
			39 01 00 00 00 00 02 00 80
			39 01 00 00 00 00 10 c0 00 74 00 10 10 00 74 10 10 00 74 00 10 10 00
			39 01 00 00 00 00 02 00 90
			39 01 00 00 00 00 09 CE 00 5C 0B 75 00 5C 00 12
			39 01 00 00 00 00 02 00 B0
			39 01 00 00 00 00 04 CE 04 00 72
			39 01 00 00 00 00 02 00 9B
			39 01 00 00 00 00 04 CE 01 16 07
			// For Desense
			39 01 00 00 00 00 02 00 B0
			39 01 00 00 00 00 05 C5 10 00 00 00
			39 01 00 00 00 00 02 00 C1
			39 01 00 00 00 00 02 C5 44
			39 01 00 00 00 00 02 00 80
			39 01 00 00 00 00 02 C4 41
			39 01 00 00 00 00 02 00 94
			39 01 00 00 00 00 02 C5 66
			39 01 00 00 00 00 02 00 98
			39 01 00 00 00 00 03 C5 56 60
			39 01 00 00 00 00 02 00 88
			39 01 00 00 00 00 03 C3 22 22
			39 01 00 00 00 00 02 00 98
			39 01 00 00 00 00 03 C3 22 22
			39 01 00 00 00 00 02 00 D6
			39 01 00 00 00 00 02 C0 08

			//CABC parameter V51
			39 01 00 00 00 00 02 00 81
			39 01 00 00 00 00 0A CA f0 ff c8 ff b4 ff 00 00 00
			39 01 00 00 00 00 02 00 00
			39 01 00 00 00 00 02 C6 10
			39 01 00 00 00 00 02 00 00
			39 01 00 00 00 00 13 C7 a0 ac ac ba cd aa bb cb ca bb ca ab ab 78 56 34 12 11
			39 01 00 00 00 00 02 00 00
			39 01 00 00 00 00 02 C6 11
			39 01 00 00 00 00 02 00 00
			39 01 00 00 00 00 13 C7 a0 ab 9c ab cc 9b ba cb b9 bb ba bb a9 78 56 34 12 11
			39 01 00 00 00 00 02 00 00
			39 01 00 00 00 00 02 C6 12
			39 01 00 00 00 00 02 00 00
			39 01 00 00 00 00 13 C7 a0 ba 9b aa cc 9a aa cb aa ba ba aa 9a 78 56 34 12 11
			39 01 00 00 00 00 02 00 00
			39 01 00 00 00 00 02 C6 13
			39 01 00 00 00 00 02 00 00
			39 01 00 00 00 00 13 C7 90 ab 9b 9a bc 9b a9 ca 9a aa ab aa a9 78 56 34 12 11
			39 01 00 00 00 00 02 00 00
			39 01 00 00 00 00 02 C6 14
			39 01 00 00 00 00 02 00 00
			39 01 00 00 00 00 13 C7 90 aa 9b a9 ca 9a a9 ba 9a aa ba a9 99 78 56 34 12 11
			39 01 00 00 00 00 02 00 00
			39 01 00 00 00 00 02 C6 15
			39 01 00 00 00 00 02 00 00
			39 01 00 00 00 00 13 C7 90 9a 8b 9a bb 9a 99 ba 9a a8 ca 99 99 88 56 34 12 11
			39 01 00 00 00 00 02 00 00
			39 01 00 00 00 00 02 C6 16
			39 01 00 00 00 00 02 00 00
			39 01 00 00 00 00 13 C7 90 9a 9a 99 ba 9a 98 aa aa 98 ba 8a 89 88 67 45 23 11
			39 01 00 00 00 00 02 00 00
			39 01 00 00 00 00 02 C6 17
			39 01 00 00 00 00 02 00 00
			39 01 00 00 00 00 13 C7 90 99 9a 99 b9 a9 98 a9 aa 88 ba 8a 98 88 78 45 23 22
			39 01 00 00 00 00 02 00 00
			39 01 00 00 00 00 02 C6 18
			39 01 00 00 00 00 02 00 00
			39 01 00 00 00 00 13 C7 80 9a 8a 99 a9 8a 89 a9 9a 98 b9 99 88 88 78 56 34 23
			39 01 00 00 00 00 02 00 00
			39 01 00 00 00 00 02 C6 19
			39 01 00 00 00 00 02 00 00
			39 01 00 00 00 00 13 C7 80 99 8a 89 b9 99 98 a8 a9 88 a9 9a 87 88 88 67 35 33
			39 01 00 00 00 00 02 00 00
			39 01 00 00 00 00 02 C6 1a
			39 01 00 00 00 00 02 00 00
			39 01 00 00 00 00 13 C7 80 99 99 88 a9 99 98 98 a9 79 a9 99 88 88 88 67 45 44
			39 01 00 00 00 00 02 00 00
			39 01 00 00 00 00 02 C6 1b
			39 01 00 00 00 00 02 00 00
			39 01 00 00 00 00 13 C7 80 98 99 89 89 99 89 98 99 79 99 8a 88 88 88 78 56 44
			39 01 00 00 00 00 02 00 00
			39 01 00 00 00 00 02 C6 1c
			39 01 00 00 00 00 02 00 00
			39 01 00 00 00 00 13 C7 80 98 89 89 89 89 89 98 a8 88 98 99 78 88 88 88 57 55
			39 01 00 00 00 00 02 00 00
			39 01 00 00 00 00 02 C6 1d
			39 01 00 00 00 00 02 00 00
			39 01 00 00 00 00 13 C7 A0 88 89 89 98 98 88 98 89 98 97 89 88 88 88 88 67 66
			39 01 00 00 00 00 02 00 00
			39 01 00 00 00 00 02 C6 1e
			39 01 00 00 00 00 02 00 00
			39 01 00 00 00 00 13 C7 A0 88 89 88 88 89 88 98 98 88 88 89 88 88 88 88 78 67
			39 01 00 00 00 00 02 00 00
			39 01 00 00 00 00 02 C6 1f
			39 01 00 00 00 00 02 00 00
			39 01 00 00 00 00 13 C7 70 88 88 88 88 89 88 88 98 87 98 88 88 88 88 88 88 78
			39 01 00 00 00 00 02 00 00
			39 01 00 00 00 00 02 C6 00
			//CABC parameter

			// CMD2 mode off
			39 01 00 00 00 00 02 00 00
			39 01 00 00 00 00 04 FF 00 00 00
			39 01 00 00 00 00 02 00 80
			39 01 00 00 00 00 03 FF 00 00

			39 01 00 00 00 00 02 35 00
			// CABC OFF mode
			39 01 00 00 00 00 02 53 24
			39 01 00 00 00 00 02 55 00
			39 01 00 00 64 00 01 11
			39 01 00 00 00 00 01 29];
		qcom,mdss-dsi-cabc-on-command = [
			// CMD2 mode on
			39 01 00 00 00 00 02 00 00
			39 01 00 00 00 00 04 FF 87 16 01
			39 01 00 00 00 00 02 00 80
			39 01 00 00 00 00 03 FF 87 16
			// resolution 1080x2246
			39 01 00 00 00 00 02 00 00
			39 01 00 00 00 00 05 2A 00 00 04 37
			39 01 00 00 00 00 02 00 00
			39 01 00 00 00 00 05 2B 00 00 08 C5
			// PWM Freq. = 34.18K
			39 01 00 00 00 00 02 00 B0
			39 01 00 00 00 00 03 CA 00 00
			// PWM = 10bit
			39 01 00 00 00 00 02 00 B2
			39 01 00 00 00 00 02 CA 04
			// Dimming Frame = 32
			39 01 00 00 00 00 02 00 B5
			39 01 00 00 00 00 02 CA 20
			//reload the error OTP set
			39 01 00 00 00 00 02 00 80
			39 01 00 00 00 00 10 c0 00 74 00 10 10 00 74 10 10 00 74 00 10 10 00
			39 01 00 00 00 00 02 00 90
			39 01 00 00 00 00 09 CE 00 5C 0B 75 00 5C 00 12
			39 01 00 00 00 00 02 00 B0
			39 01 00 00 00 00 04 CE 04 00 72
			39 01 00 00 00 00 02 00 9B
			39 01 00 00 00 00 04 CE 01 16 07
			// For Desense
			39 01 00 00 00 00 02 00 B0
			39 01 00 00 00 00 05 C5 10 00 00 00
			39 01 00 00 00 00 02 00 C1
			39 01 00 00 00 00 02 C5 44
			39 01 00 00 00 00 02 00 80
			39 01 00 00 00 00 02 C4 41
			39 01 00 00 00 00 02 00 94
			39 01 00 00 00 00 02 C5 66
			39 01 00 00 00 00 02 00 98
			39 01 00 00 00 00 03 C5 56 60
			39 01 00 00 00 00 02 00 88
			39 01 00 00 00 00 03 C3 22 22
			39 01 00 00 00 00 02 00 98
			39 01 00 00 00 00 03 C3 22 22
			39 01 00 00 00 00 02 00 D6
			39 01 00 00 00 00 02 C0 08
			//CABC parameter V51
			39 01 00 00 00 00 02 00 81
			39 01 00 00 00 00 0A CA f0 ff c8 ff b4 ff 00 00 00
			39 01 00 00 00 00 02 00 00
			39 01 00 00 00 00 02 C6 10
			39 01 00 00 00 00 02 00 00
			39 01 00 00 00 00 13 C7 a0 ac ac ba cd aa bb cb ca bb ca ab ab 78 56 34 12 11
			39 01 00 00 00 00 02 00 00
			39 01 00 00 00 00 02 C6 11
			39 01 00 00 00 00 02 00 00
			39 01 00 00 00 00 13 C7 a0 ab 9c ab cc 9b ba cb b9 bb ba bb a9 78 56 34 12 11
			39 01 00 00 00 00 02 00 00
			39 01 00 00 00 00 02 C6 12
			39 01 00 00 00 00 02 00 00
			39 01 00 00 00 00 13 C7 a0 ba 9b aa cc 9a aa cb aa ba ba aa 9a 78 56 34 12 11
			39 01 00 00 00 00 02 00 00
			39 01 00 00 00 00 02 C6 13
			39 01 00 00 00 00 02 00 00
			39 01 00 00 00 00 13 C7 90 ab 9b 9a bc 9b a9 ca 9a aa ab aa a9 78 56 34 12 11
			39 01 00 00 00 00 02 00 00
			39 01 00 00 00 00 02 C6 14
			39 01 00 00 00 00 02 00 00
			39 01 00 00 00 00 13 C7 90 aa 9b a9 ca 9a a9 ba 9a aa ba a9 99 78 56 34 12 11
			39 01 00 00 00 00 02 00 00
			39 01 00 00 00 00 02 C6 15
			39 01 00 00 00 00 02 00 00
			39 01 00 00 00 00 13 C7 90 9a 8b 9a bb 9a 99 ba 9a a8 ca 99 99 88 56 34 12 11
			39 01 00 00 00 00 02 00 00
			39 01 00 00 00 00 02 C6 16
			39 01 00 00 00 00 02 00 00
			39 01 00 00 00 00 13 C7 90 9a 9a 99 ba 9a 98 aa aa 98 ba 8a 89 88 67 45 23 11
			39 01 00 00 00 00 02 00 00
			39 01 00 00 00 00 02 C6 17
			39 01 00 00 00 00 02 00 00
			39 01 00 00 00 00 13 C7 90 99 9a 99 b9 a9 98 a9 aa 88 ba 8a 98 88 78 45 23 22
			39 01 00 00 00 00 02 00 00
			39 01 00 00 00 00 02 C6 18
			39 01 00 00 00 00 02 00 00
			39 01 00 00 00 00 13 C7 80 9a 8a 99 a9 8a 89 a9 9a 98 b9 99 88 88 78 56 34 23
			39 01 00 00 00 00 02 00 00
			39 01 00 00 00 00 02 C6 19
			39 01 00 00 00 00 02 00 00
			39 01 00 00 00 00 13 C7 80 99 8a 89 b9 99 98 a8 a9 88 a9 9a 87 88 88 67 35 33
			39 01 00 00 00 00 02 00 00
			39 01 00 00 00 00 02 C6 1a
			39 01 00 00 00 00 02 00 00
			39 01 00 00 00 00 13 C7 80 99 99 88 a9 99 98 98 a9 79 a9 99 88 88 88 67 45 44
			39 01 00 00 00 00 02 00 00
			39 01 00 00 00 00 02 C6 1b
			39 01 00 00 00 00 02 00 00
			39 01 00 00 00 00 13 C7 80 98 99 89 89 99 89 98 99 79 99 8a 88 88 88 78 56 44
			39 01 00 00 00 00 02 00 00
			39 01 00 00 00 00 02 C6 1c
			39 01 00 00 00 00 02 00 00
			39 01 00 00 00 00 13 C7 80 98 89 89 89 89 89 98 a8 88 98 99 78 88 88 88 57 55
			39 01 00 00 00 00 02 00 00
			39 01 00 00 00 00 02 C6 1d
			39 01 00 00 00 00 02 00 00
			39 01 00 00 00 00 13 C7 A0 88 89 89 98 98 88 98 89 98 97 89 88 88 88 88 67 66
			39 01 00 00 00 00 02 00 00
			39 01 00 00 00 00 02 C6 1e
			39 01 00 00 00 00 02 00 00
			39 01 00 00 00 00 13 C7 A0 88 89 88 88 89 88 98 98 88 88 89 88 88 88 88 78 67
			39 01 00 00 00 00 02 00 00
			39 01 00 00 00 00 02 C6 1f
			39 01 00 00 00 00 02 00 00
			39 01 00 00 00 00 13 C7 70 88 88 88 88 89 88 88 98 87 98 88 88 88 88 88 88 78
			39 01 00 00 00 00 02 00 00
			39 01 00 00 00 00 02 C6 00
			//CABC parameter

			// CMD2 mode off
			39 01 00 00 00 00 02 00 00
			39 01 00 00 00 00 04 FF 00 00 00
			39 01 00 00 00 00 02 00 80
			39 01 00 00 00 00 03 FF 00 00

			39 01 00 00 00 00 02 35 00
			// CABC moving mode
			39 01 00 00 00 00 02 53 24
			39 01 00 00 00 00 02 55 03
			39 01 00 00 64 00 01 11
			39 01 00 00 00 00 01 29];
		//qcom,mdss-dsi-off-command = [
			//05 01 00 00 03 00 02 28 00
			//05 01 00 00 80 00 02 10 00
			//15 01 00 00 00 00 02 00 00
			//39 01 00 00 00 00 05 F7 5A A5 87 16];
		//qcom,mdss-dsi-on-command-state = "dsi_lp_mode";
		//qcom,mdss-dsi-off-command-state = "dsi_lp_mode";
		//qcom,mdss-dsi-h-sync-pulse = <1>;
		qcom,mdss-dsi-traffic-mode = "burst_mode";
		qcom,mdss-dsi-lane-map = "lane_map_0123";
		qcom,mdss-dsi-bllp-eof-power-mode;
		qcom,mdss-dsi-bllp-power-mode;
		qcom,mdss-dsi-lane-0-state;
		qcom,mdss-dsi-lane-1-state;
		qcom,mdss-dsi-lane-2-state;
		qcom,mdss-dsi-lane-3-state;
		qcom,mdss-dsi-lp11-init;
		//qcom,mdss-dsi-panel-timings-phy-v2 = [
			//25 20 09 0a 06 03 04 a0
			//25 20 09 0a 06 03 04 a0
			//25 20 09 0a 06 03 04 a0
			//25 20 09 0a 06 03 04 a0
			//25 1f 09 0a 06 03 04 a0];
		//qcom,mdss-dsi-t-clk-post = <0x03>;
		//qcom,mdss-dsi-t-clk-pre = <0x28>;
		//qcom,mdss-dsi-bl-min-level = <1>;
		//qcom,mdss-dsi-bl-max-level = <1023>;
		qcom,mdss-dsi-dma-trigger = "trigger_sw";
		qcom,mdss-dsi-mdp-trigger = "none";
		//qcom,mdss-dsi-bl-pmic-control-type = "bl_ctrl_dcs";
		//qcom,mdss-dsi-mode-sel-gpio-state = "dual_port";
		qcom,mdss-dsi-reset-sequence = <1 1>, <0 1>, <1 2>;
		//qcom,panel-supply-entries = <&dsi_panel_pwr_supply>;
		qcom,ulps-enabled;
		//qcom,suspend-ulps-enabled;
		qcom,mdss-dsi-display-timings {
			timing@0{
				qcom,mdss-dsi-panel-width = <1080>;
				qcom,mdss-dsi-panel-height = <2246>;
				qcom,mdss-dsi-h-front-porch = <78>;
				qcom,mdss-dsi-h-back-porch = <78>;
				qcom,mdss-dsi-h-pulse-width = <12>;
				qcom,mdss-dsi-h-sync-skew = <0>;
				qcom,mdss-dsi-v-back-porch = <16>;
				qcom,mdss-dsi-v-front-porch = <16>;
				qcom,mdss-dsi-v-pulse-width = <2>;
				qcom,mdss-dsi-h-left-border = <0>;
				qcom,mdss-dsi-h-right-border = <0>;
				qcom,mdss-dsi-v-top-border = <0>;
				qcom,mdss-dsi-v-bottom-border = <0>;
				qcom,mdss-dsi-panel-framerate = <60>;
				qcom,mdss-dsi-on-command = [
					// CMD2 mode on
					39 01 00 00 00 00 02 00 00
					39 01 00 00 00 00 04 FF 87 16 01
					39 01 00 00 00 00 02 00 80
					39 01 00 00 00 00 03 FF 87 16
					// resolution 1080x2246
					39 01 00 00 00 00 02 00 00
					39 01 00 00 00 00 05 2A 00 00 04 37
					39 01 00 00 00 00 02 00 00
					39 01 00 00 00 00 05 2B 00 00 08 C5
					// PWM Freq. = 34.18K
					39 01 00 00 00 00 02 00 B0
					39 01 00 00 00 00 03 CA 00 00
					// PWM = 10bit
					39 01 00 00 00 00 02 00 B2
					39 01 00 00 00 00 02 CA 04
					// Dimming Frame = 32
					39 01 00 00 00 00 02 00 B5
					39 01 00 00 00 00 02 CA 20
					//reload the error OTP set
					39 01 00 00 00 00 02 00 80
					39 01 00 00 00 00 10 c0 00 74 00 10 10 00 74 10 10 00 74 00 10 10 00
					39 01 00 00 00 00 02 00 90
					39 01 00 00 00 00 09 CE 00 5C 0B 75 00 5C 00 12
					39 01 00 00 00 00 02 00 B0
					39 01 00 00 00 00 04 CE 04 00 72
					39 01 00 00 00 00 02 00 9B
					39 01 00 00 00 00 04 CE 01 16 07
					// For Desense
					39 01 00 00 00 00 02 00 B0
					39 01 00 00 00 00 05 C5 10 00 00 00
					39 01 00 00 00 00 02 00 C1
					39 01 00 00 00 00 02 C5 44
					39 01 00 00 00 00 02 00 80
					39 01 00 00 00 00 02 C4 41
					39 01 00 00 00 00 02 00 94
					39 01 00 00 00 00 02 C5 66
					39 01 00 00 00 00 02 00 98
					39 01 00 00 00 00 03 C5 56 60
					39 01 00 00 00 00 02 00 88
					39 01 00 00 00 00 03 C3 22 22
					39 01 00 00 00 00 02 00 98
					39 01 00 00 00 00 03 C3 22 22
					39 01 00 00 00 00 02 00 D6
					39 01 00 00 00 00 02 C0 08

					//CABC parameter V51
					39 01 00 00 00 00 02 00 81
					39 01 00 00 00 00 0A CA f0 ff c8 ff b4 ff 00 00 00
					39 01 00 00 00 00 02 00 00
					39 01 00 00 00 00 02 C6 10
					39 01 00 00 00 00 02 00 00
					39 01 00 00 00 00 13 C7 a0 ac ac ba cd aa bb cb ca bb ca ab ab 78 56 34 12 11
					39 01 00 00 00 00 02 00 00
					39 01 00 00 00 00 02 C6 11
					39 01 00 00 00 00 02 00 00
					39 01 00 00 00 00 13 C7 a0 ab 9c ab cc 9b ba cb b9 bb ba bb a9 78 56 34 12 11
					39 01 00 00 00 00 02 00 00
					39 01 00 00 00 00 02 C6 12
					39 01 00 00 00 00 02 00 00
					39 01 00 00 00 00 13 C7 a0 ba 9b aa cc 9a aa cb aa ba ba aa 9a 78 56 34 12 11
					39 01 00 00 00 00 02 00 00
					39 01 00 00 00 00 02 C6 13
					39 01 00 00 00 00 02 00 00
					39 01 00 00 00 00 13 C7 90 ab 9b 9a bc 9b a9 ca 9a aa ab aa a9 78 56 34 12 11
					39 01 00 00 00 00 02 00 00
					39 01 00 00 00 00 02 C6 14
					39 01 00 00 00 00 02 00 00
					39 01 00 00 00 00 13 C7 90 aa 9b a9 ca 9a a9 ba 9a aa ba a9 99 78 56 34 12 11
					39 01 00 00 00 00 02 00 00
					39 01 00 00 00 00 02 C6 15
					39 01 00 00 00 00 02 00 00
					39 01 00 00 00 00 13 C7 90 9a 8b 9a bb 9a 99 ba 9a a8 ca 99 99 88 56 34 12 11
					39 01 00 00 00 00 02 00 00
					39 01 00 00 00 00 02 C6 16
					39 01 00 00 00 00 02 00 00
					39 01 00 00 00 00 13 C7 90 9a 9a 99 ba 9a 98 aa aa 98 ba 8a 89 88 67 45 23 11
					39 01 00 00 00 00 02 00 00
					39 01 00 00 00 00 02 C6 17
					39 01 00 00 00 00 02 00 00
					39 01 00 00 00 00 13 C7 90 99 9a 99 b9 a9 98 a9 aa 88 ba 8a 98 88 78 45 23 22
					39 01 00 00 00 00 02 00 00
					39 01 00 00 00 00 02 C6 18
					39 01 00 00 00 00 02 00 00
					39 01 00 00 00 00 13 C7 80 9a 8a 99 a9 8a 89 a9 9a 98 b9 99 88 88 78 56 34 23
					39 01 00 00 00 00 02 00 00
					39 01 00 00 00 00 02 C6 19
					39 01 00 00 00 00 02 00 00
					39 01 00 00 00 00 13 C7 80 99 8a 89 b9 99 98 a8 a9 88 a9 9a 87 88 88 67 35 33
					39 01 00 00 00 00 02 00 00
					39 01 00 00 00 00 02 C6 1a
					39 01 00 00 00 00 02 00 00
					39 01 00 00 00 00 13 C7 80 99 99 88 a9 99 98 98 a9 79 a9 99 88 88 88 67 45 44
					39 01 00 00 00 00 02 00 00
					39 01 00 00 00 00 02 C6 1b
					39 01 00 00 00 00 02 00 00
					39 01 00 00 00 00 13 C7 80 98 99 89 89 99 89 98 99 79 99 8a 88 88 88 78 56 44
					39 01 00 00 00 00 02 00 00
					39 01 00 00 00 00 02 C6 1c
					39 01 00 00 00 00 02 00 00
					39 01 00 00 00 00 13 C7 80 98 89 89 89 89 89 98 a8 88 98 99 78 88 88 88 57 55
					39 01 00 00 00 00 02 00 00
					39 01 00 00 00 00 02 C6 1d
					39 01 00 00 00 00 02 00 00
					39 01 00 00 00 00 13 C7 A0 88 89 89 98 98 88 98 89 98 97 89 88 88 88 88 67 66
					39 01 00 00 00 00 02 00 00
					39 01 00 00 00 00 02 C6 1e
					39 01 00 00 00 00 02 00 00
					39 01 00 00 00 00 13 C7 A0 88 89 88 88 89 88 98 98 88 88 89 88 88 88 88 78 67
					39 01 00 00 00 00 02 00 00
					39 01 00 00 00 00 02 C6 1f
					39 01 00 00 00 00 02 00 00
					39 01 00 00 00 00 13 C7 70 88 88 88 88 89 88 88 98 87 98 88 88 88 88 88 88 78
					39 01 00 00 00 00 02 00 00
					39 01 00 00 00 00 02 C6 00
					//CABC parameter

					// CMD2 mode off
					39 01 00 00 00 00 02 00 00
					39 01 00 00 00 00 04 FF 00 00 00
					39 01 00 00 00 00 02 00 80
					39 01 00 00 00 00 03 FF 00 00

					39 01 00 00 00 00 02 35 00
					// CABC OFF mode
					39 01 00 00 00 00 02 53 24
					39 01 00 00 00 00 02 55 00
					39 01 00 00 64 00 01 11
					39 01 00 00 00 00 01 29];
				qcom,mdss-dsi-off-command = [
					05 01 00 00 03 00 02 28 00
					05 01 00 00 80 00 02 10 00
					15 01 00 00 00 00 02 00 00
					39 01 00 00 00 00 05 F7 5A A5 87 16];
				qcom,mdss-dsi-on-command-state = "dsi_lp_mode";
				qcom,mdss-dsi-off-command-state = "dsi_lp_mode";
				qcom,mdss-dsi-h-sync-pulse = <1>;
			};
		};

	};
};

