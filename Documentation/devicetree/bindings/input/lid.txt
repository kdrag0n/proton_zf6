## Documentation/devicetree/bindings/input/lid.txt
```
Hall sensor driver

Hall sensor is a switch. It senses magnetic field change and trigger interrupts to cpu.

Required properties:

 - compatible	: Should be "asustek_lid".
 - pinctrl-names: Pinctrl configuration names of this sensor driver.
				Should be "default".
 - gpios	: Irq gpio which is to provide interrupts to host.
		Eg: <&pio 0 0>
			<[phandle of the gpio controller node]
			 [line number within the gpio controller]
			 [flags]>

		Values for gpio specifier:
			- Line number: is a value between 0 to 202.
			- Flags:  bit field of flags, as defined in <dt-bindings/gpio/gpio.h>.
		Only the following flags are supported:
			0 - GPIO_ACTIVE_HIGH
			1 - GPIO_ACTIVE_LOW

Optional properties:

 - asustek_lid,wakeup	: Boolean to select interrupt wakeup or not, if this property is defined
				device will wakeup system.

Example:
XXX_msmXXX-mtp.dtsi
 &soc {
	asustek_lid {
		compatible = "asustek_lid";
		pinctrl-names = "asustek_lid_active", "asustek_lid_suspend";
		pinctrl-0 = <&asustek_lid_active>;
		pinctrl-1 = <&asustek_lid_suspend>;
		gpios = <&msm_gpio 139 0x1>;
		asustek_lid,wakeup;
	};
 };

XXX_msmXXX-pinctrl.dtsi
 &soc {
	tlmm_pinmux: pinctrl@1000000 {
		/* add pingrp for hall sensor */
		asustek_lid_gpio {
			qcom,pins = <&gp 139>;
			qcom,pin-func = <0>;
			qcom,num-grp-pins = <1>;
			label = "asustek_lid_gpio";
			asustek_lid_active: asustek_lid_active {
				drive-strength = <2>;	/* 2 MA */
				bias-pull-up;		/* pull-up */
			};
			asustek_lid_suspend: asustek_lid_suspend {
				drive-strength = <2>;	/* 2 MA */
				bias-pull-up;		/* pull-up */
			};
		};
 };
```

## Documentation/devicetree/bindings/media/video/laser-sensor.txt
```
Laser Sensor Device Tree Bindings.
========================================

Boards with the Laser Sensor connected to CCI shall have the following
properties:

Required node properties:
	- cell-index: cci hardware core index
	- compatible:
		- "st,stmvl53l1" : STMiecroelectronics VL53L1 Laser sensor.
	- reg : offset and length of the register set for the device
	- cci-master: cci master the sensor connected to
	- cci-device: cci device the sensor connected to
	- cci-supply : cci voltage regulator used
	- laser-supply: laser sensor voltage regulator
	- intr-gpio: irq gpio which is to provide interrupts to host
	- xsdn-gpio: laser sensor shutdown gpio
```

## drivers/input/touchscreen/focaltech_touch_ft8719/Kconfig
```kconfig
#
# Focaltech Touchscreen driver configuration
#

config TOUCHSCREEN_FTS
        bool "Focaltech Touchscreen"
		depends on I2C
		default n
		help
		  Say Y here if you have Focaltech touch panel.
		  If unsure, say N.
    
```

## drivers/staging/qcacld-3.0/Kconfig
```kconfig
comment "Qualcomm Atheros CLD WLAN module"

config QCA_CLD_WLAN
	tristate "Qualcomm Atheros CLD WLAN module"
	default n
	help
	  Add support for the Qualcomm Atheros CLD WLAN module

if QCA_CLD_WLAN != n

config QCA_CLD_WLAN_PROFILE
	string "Configuration profile for Qualcomm Atheros CLD WLAN module"
	default "default"
	help
	  Specify which configuration profile to be used for building
	  this module.

	  Profiles are located at drivers/staging/qcacld-3.0/configs.

config QCA_CLD_DEBUG
	bool "Debug Qualcomm Atheros CLD WLAN module"
	default n

config WLAN_DEBUG
	bool "Also debugging for qcacld driver"
	default n

endif # QCA_CLD_WLAN
```
